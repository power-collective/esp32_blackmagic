## main/Kconfig.projbuild
```kconfig
menu "Wi-Fi Configuration"

config WIFI_SSID
    string "WiFi SSID"
	default "blackmagic"
	help
		In AP mode: SSID (network name) for the access point to create.
		In STA mode: SSID (network name) to connect to.

config WIFI_PASSWORD
    string "WiFi Password"
	default "blackmagic"
	help
		WiFi password (WPA2) - minimum 8 characters.
		In AP mode: Password for clients to connect to this device.
		In STA mode: Password for connecting to existing network.

		Leave blank for open network (AP mode only, not recommended).

endmenu
```
